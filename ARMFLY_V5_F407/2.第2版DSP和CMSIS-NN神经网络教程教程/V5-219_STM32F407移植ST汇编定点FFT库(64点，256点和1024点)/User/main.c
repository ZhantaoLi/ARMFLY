/*
*********************************************************************************************************
*
*	模块名称 : 主程序模块
*	文件名称 : main.c
*	版    本 : V1.0
*	说    明 : 移植ST汇编定点FFT库（64点，256点和1024点）
*              实验目的：
*                1. 学习ST汇编定点FFT库（64点，256点和1024点）
*              实验内容： 
*                1. 启动一个自动重装软件定时器，每100ms翻转一次LED2。
*                2.	按下按键K1，串口打印1024点FFT的幅频响应和相频响应。
*                3.	按下按键K2，串口打印256点FFT的幅频响应。
*                4.	按下按键K3，串口打印64点FFT的幅频响应。
*              注意事项：
*                1. 打印方式：
*                   方式一：
*                     默认使用串口打印，可以使用SecureCRT或者H7-TOOL上位机串口助手查看打印信息，
*                     波特率115200，数据位8，奇偶校验位无，停止位1。
*                   方式二：
*                     使用RTT打印，可以使用SEGGE RTT或者H7-TOOL RTT打印。
*                     MDK AC5，MDK AC6或IAR通过使能bsp.h文件中的宏定义为1即可
*                     #define Enable_RTTViewer  1
*                2. 务必将编辑器的缩进参数和TAB设置为4来阅读本文件，要不代码显示不整齐。
*
*	修改记录 :
*		版本号   日期         作者        说明
*		V1.0    2020-05-16   Eric2013     1. CMSIS软包版本 V5.7.0
*                                         2. HAL库版本 V1.7.6
*
*	Copyright (C), 2020-2030, 安富莱电子 www.armfly.com
*
*********************************************************************************************************
*/	
#include "bsp.h"			 /* 底层硬件驱动 */
#include "arm_math.h"
#include "stm32_dsp.h"


/* 定义例程名和例程发布日期 */
#define EXAMPLE_NAME	"V5-汇编定点FFT库（64点，256点和1024点）"
#define EXAMPLE_DATE	"2021-05-16"
#define DEMO_VER		"1.0"


/* 仅允许本文件内调用的函数声明 */
static void PrintfLogo(void);
static void PrintfHelp(void);

uint32_t input[1024], output[1024], Mag[1024];/* 输入，输出和幅值 */ 
float32_t Phase[1024]; /* 相位*/ 

/*
*********************************************************************************************************
*	函 数 名: PowerMag
*	功能说明: 求模值
*	形    参：_usFFTPoints  FFT点数
*	返 回 值: 无
*********************************************************************************************************
*/
void PowerMag(uint16_t _usFFTPoints)		
{
	int16_t lX,lY;
	uint16_t i;
	float32_t mag;

	/* 计算幅值 */
	for (i=0; i < _usFFTPoints; i++)
	{
 		lX= (output[i]<<16)>>16;                    /* 实部*/
		lY= (output[i]>> 16);                       /* 虚部 */    
		arm_sqrt_f32((float32_t)(lX*lX+ lY*lY), &mag);     /* 求模 */
		Mag[i]= mag*2;                    /* 求模后乘以2才是实际模值，直流分量不需要乘2 */
	}
     
	/* 由于上面多乘了2，所以这里直流分量要除以2 */
	Mag[0] = Mag[0]>>1;
}

/*
*********************************************************************************************************
*	函 数 名: Power_Phase_Radians
*	功能说明: 求相位
*	形    参：_usFFTPoints  FFT点数
*	返 回 值: 无
*********************************************************************************************************
*/
void Power_Phase_Radians(uint16_t _usFFTPoints, uint32_t _uiCmpValue)		
{
	int16_t lX, lY;
	uint16_t i;
	float32_t phase;
	float32_t mag;
	
	
	for (i=0; i <_usFFTPoints; i++)
	{
		lX= (output[i]<<16)>>16;  /* 实部 */
		lY= (output[i] >> 16);    /* 虚部 */ 
		
 		phase = atan2(lY, lX);    		  /* atan2求解的结果范围是(-pi, pi], 弧度制 */
		arm_sqrt_f32((float32_t)(lX*lX+ lY*lY), &mag);   /* 求模 */
		
		if(_uiCmpValue > mag)
		{
			Phase[i] = 0;			
		}
		else
		{
			Phase[i] = phase* 180.0f/3.1415926f;  /* 将求解的结果由弧度转换为角度 */
		}
	}
}

/*
*********************************************************************************************************
*	函 数 名: DSP_FFTPhase
*	功能说明: 1024点FFT的相位求解
*	形    参：无
*	返 回 值: 无
*********************************************************************************************************
*/
void DSP_FFTPhase(void)
{
	uint16_t i;
	
	/* 获得1024个采样点 */
	for (i = 0; i < 1024; i++)
	{
		/* 波形是由直流分量，50Hz正弦波组成，波形采样率1024，初始相位60° */
		input[i] = 1024 + 1024*cos(2*3.1415926f*50*i/1024 + 3.1415926f/3);
	}
	
	/* 计算1024点FFT 
	   output：输出结果，高16位是虚部，低16位是实部。
	   input ：输入数据，高16位是虚部，低16位是实部。
	   第三个参数必须是1024。
	*/
	cr4_fft_1024_stm32(output, input, 1024); 
	
	/* 求幅值 */
	PowerMag(1024);
	
	/* 打印输出结果 */
	for (i = 0; i < 1024; i++)
	{
		printf("%d\r\n", Mag[i]);
	}
	
	printf("=========================================\r\n");	
	
	/* 求相频 */
	Power_Phase_Radians(1024, 100);
	
	
	/* 打印输出结果 */
	for (i = 0; i < 1024; i++)
	{
		printf("%f\r\n", Phase[i]);
	}
}

/*
*********************************************************************************************************
*	函 数 名: DSP_FFT256
*	功能说明: 256点FFT实现
*	形    参：无
*	返 回 值: 无
*********************************************************************************************************
*/
void DSP_FFT256(void)
{
	uint16_t i;
	
	/* 获得256个采样点 */
	for (i = 0; i < 256; i++)
	{
		/* 波形是由直流分量，50Hz正弦波和20Hz正弦波组成，波形采样率200Hz */
		input[i] = 1024 + 1024*sin(2*3.1415926f*50*i/200) + 512*sin(2*3.1415926f*20*i/200) ;
	}
	
	/* 计算256点FFT 
	   output：输出结果，高16位是虚部，低16位是实部。
	   input ：输入数据，高16位是虚部，低16位是实部。
	   第三个参数必须是1024。
	*/
	cr4_fft_256_stm32(output, input, 256); 
	
	/* 求幅值 */
	PowerMag(256);
	
	/* 打印输出结果 */
	for (i = 0; i < 256; i++)
	{
		printf("%d\r\n", Mag[i]);
	}
}

/*
*********************************************************************************************************
*	函 数 名: DSP_FFT64
*	功能说明: 64点FFT实现
*	形    参：无
*	返 回 值: 无
*********************************************************************************************************
*/
void DSP_FFT64(void)
{
	uint16_t i;
	
	/* 获得64个采样点 */
	for (i = 0; i < 64; i++)
	{
		/* 波形是由直流分量，5Hz正弦波和10Hz正弦波组成，波形采样率60Hz */
		input[i] = 1024 + 1024*sin(2*3.1415926f*5*i/60) + 512*sin(2*3.1415926f*10*i/60) ;
	}
	
	/* 计算64点FFT 
	   output：输出结果，高16位是虚部，低16位是实部。
	   input ：输入数据，高16位是虚部，低16位是实部。
	   第三个参数必须是1024。
	*/
	cr4_fft_64_stm32(output, input, 64); 
	
	/* 求幅值 */
	PowerMag(64);
	
	/* 打印输出结果 */
	for (i = 0; i < 64; i++)
	{
		printf("%d\r\n", Mag[i]);
	}
}

/*
*********************************************************************************************************
*	函 数 名: main
*	功能说明: c程序入口
*	形    参: 无
*	返 回 值: 错误代码(无需处理)
*********************************************************************************************************
*/
int main(void)
{
	uint8_t ucKeyCode;		/* 按键代码 */
	

	bsp_Init();		/* 硬件初始化 */
	PrintfLogo();	/* 打印例程信息到串口1 */

	PrintfHelp();	/* 打印操作提示信息 */
	

	bsp_StartAutoTimer(0, 100);	/* 启动1个100ms的自动重装的定时器 */

	/* 进入主程序循环体 */
	while (1)
	{
		bsp_Idle();		/* 这个函数在bsp.c文件。用户可以修改这个函数实现CPU休眠和喂狗 */

		if (bsp_CheckTimer(0))	/* 判断定时器超时时间 */
		{
			/* 每隔500ms 进来一次 */
			bsp_LedToggle(4);	/* 翻转LED2的状态 */   
		}
		
		ucKeyCode = bsp_GetKey();	/* 读取键值, 无键按下时返回 KEY_NONE = 0 */
		if (ucKeyCode != KEY_NONE)
		{
			switch (ucKeyCode)
			{
				case KEY_DOWN_K1:		    /* K1键按下 */
					DSP_FFTPhase();
					break;
				
				case KEY_DOWN_K2:		    /* K2键按下 */
					DSP_FFT256();
					break;
				
				case KEY_DOWN_K3:		    /* K3键按下 */
					DSP_FFT64();
					break;
				
					
				default:
					/* 其它的键值不处理 */
					break;
			}
		}

	}
}

/*
*********************************************************************************************************
*	函 数 名: PrintfHelp
*	功能说明: 显示操作提示菜单
*	形    参: 无
*	返 回 值: 无
*********************************************************************************************************
*/
static void PrintfHelp(void)
{
	printf("操作提示:\r\n");
	printf("1. 启动一个自动重装软件定时器，每100ms翻转一次LED2\r\n");
	printf("2. 按下按键K1，串口打印1024点FFT的幅频响应和相频响应\r\n");
	printf("3. 按下按键K2，串口打印256点FFT的幅频响应\r\n");
	printf("4. 按下按键K3，串口打印64点FFT的幅频响应\r\n");
}

/*
*********************************************************************************************************
*	函 数 名: PrintfLogo
*	功能说明: 打印例程名称和例程发布日期, 接上串口线后，打开PC机的超级终端软件可以观察结果
*	形    参: 无
*	返 回 值: 无
*********************************************************************************************************
*/
static void PrintfLogo(void)
{
	printf("*************************************************************\n\r");
	
	/* 检测CPU ID */
	{
		uint32_t CPU_Sn0, CPU_Sn1, CPU_Sn2;
		
		CPU_Sn0 = *(__IO uint32_t*)(0x1FFF7A10);
		CPU_Sn1 = *(__IO uint32_t*)(0x1FFF7A10 + 4);
		CPU_Sn2 = *(__IO uint32_t*)(0x1FFF7A10 + 8);

		printf("\r\nCPU : STM32F407IGT6, LQFP176, 主频: %dMHz\r\n", SystemCoreClock / 1000000);
		printf("UID = %08X %08X %08X\n\r", CPU_Sn2, CPU_Sn1, CPU_Sn0);
	}

	printf("\n\r");
	printf("*************************************************************\n\r");
	printf("* 例程名称   : %s\r\n", EXAMPLE_NAME);	/* 打印例程名称 */
	printf("* 例程版本   : %s\r\n", DEMO_VER);		/* 打印例程版本 */
	printf("* 发布日期   : %s\r\n", EXAMPLE_DATE);	/* 打印例程日期 */

	/* 打印ST的HAL库版本 */
	printf("* HAL库版本  : V1.7.6 (STM32F407 HAL Driver)\r\n");
	printf("* \r\n");	/* 打印一行空格 */
	printf("* QQ    : 1295744630 \r\n");
	printf("* 旺旺  : armfly\r\n");
	printf("* Email : armfly@qq.com \r\n");
	printf("* 微信公众号: armfly_com \r\n");
	printf("* 淘宝店: armfly.taobao.com\r\n");
	printf("* Copyright www.armfly.com 安富莱电子\r\n");
	printf("*************************************************************\n\r");
}

/***************************** 安富莱电子 www.armfly.com (END OF FILE) *********************************/
